/*
 * Base documentation:
 *      https://developer.nordicsemi.com/nRF_Connect_SDK/doc/latest/zephyr/reference/kernel/index.html
 * 
 */


#include <zephyr.h>
#include <device.h>
#include <drivers/gpio.h>
#include <sys/printk.h>
#include <sys/__assert.h>
#include <string.h>
#include <timing/timing.h>
#include <stdlib.h>
#include <stdio.h>
#include "cab.h"

#define IMGWIDTH 128             /* Square image. Side size, in pixels*/

/* Static image */
uint8_t vertical_guide_image_data[IMGWIDTH][IMGWIDTH] =
    {
        {0, 0, 0, 0, 0, 0, 0, 0, 0, 0, 0, 0, 0,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 0, 0},
        {0, 0, 0, 0, 0, 0, 0, 0, 0, 0, 0, 0, 0,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 0, 0},
        {0, 0, 0, 0, 0, 0, 0, 0, 0, 0, 0, 0, 0,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 0, 0},
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        {0, 0, 0, 0, 0, 0, 0, 0, 0, 0, 0, 0, 0,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 0, 0}};


/* Cab */
cab* image_cab;

/* Size of stack area used by each thread (can be thread specific, if necessary)*/
#define STACK_SIZE 1024

#define N_PRODUCERS 1
#define N_CONSUMERS 1

/* Create thread stack space */
K_THREAD_STACK_DEFINE(p1_stack, STACK_SIZE);
K_THREAD_STACK_DEFINE(c1_stack, STACK_SIZE);
  
/* Create variables for thread data */
struct k_thread p1_data;
struct k_thread c1_data;


/* Create task IDs */
k_tid_t p1_tid;
k_tid_t c1_tid;


K_THREAD_STACK_DEFINE(p1_stack, STACK_SIZE);
K_THREAD_STACK_DEFINE(c1_stack, STACK_SIZE);


/* Thread code prototypes */
void producers_code(void *argA, void *argB, void *argC);
void consumers_code(void *argA, void *argB, void *argC);


/* Main function */
void main(void) {


    /* Initialize CAB*/

    uint8_t **img1 = (uint8_t **)malloc(IMGWIDTH * sizeof(uint8_t *));
    for (uint8_t j = 0; j < IMGWIDTH; j++)
        img1[j] = (uint8_t *)malloc(IMGWIDTH * sizeof(uint8_t));

    for (size_t i = 0; i < IMGWIDTH; i++)
        for (size_t j = 0; j < IMGWIDTH; j++)
            img1[i][j] = vertical_guide_image_data[i][j];

    image_cab = open_cab("image cab", N_PRODUCERS+N_CONSUMERS+1, IMGWIDTH*IMGWIDTH, (void*)img1);
    
    printk("Cab initialized\n");

    p1_tid = k_thread_create(&p1_data, p1_stack, K_THREAD_STACK_SIZEOF(p1_stack), producers_code, NULL, NULL, NULL, 1, 0, K_NO_WAIT);
    printk("Thread producer created \n");
    c1_tid = k_thread_create(&c1_data, c1_stack, K_THREAD_STACK_SIZEOF(c1_stack), consumers_code, NULL, NULL, NULL, 1, 0, K_NO_WAIT);
    printk("Thread consumer created \n");

    
    return;

} 

/* Thread code implementation */
void producers_code(void *argA , void *argB, void *argC)
{
    /* Timing variables to control task periodicity */

    /* Other variables */
    
    printk("Thread producer init \n");

    /* Thread loop */
    while(1) {
        
        /* Do the workload */          
        
        /* reserve image from CAB */
        uint8_t *img = (uint8_t *)reserve(image_cab);

        memcpy(img, vertical_guide_image_data, IMGWIDTH*IMGWIDTH);

        printk("Task producer insert obstacle \n");
        img[126*IMGWIDTH+60] = 128;


        put_mes((void*)img, image_cab);
        printk("Task producer put image to CAB \n");

        k_msleep(1000);
        
    }

}

void producers_code2(void *argA , void *argB, void *argC)
{
    /* Timing variables to control task periodicity */

    /* Other variables */
    
    printk("Thread producer init \n");

    /* Thread loop */
    while(1) {
        
        /* Do the workload */          
        
        /* reserve image from CAB */
        uint8_t *img = (uint8_t *)reserve(image_cab);

        memcpy(img, vertical_guide_image_data, IMGWIDTH*IMGWIDTH);
    

        put_mes((void*)img, image_cab);
        printk("Task producer put image to CAB \n");
        
    }

}


void consumers_code(void *argA , void *argB, void *argC)
{
    /* Other variables */

    while(1) {

    /* get image from CAB*/
    uint8_t *img = (uint8_t *)get_mes(image_cab);

    if(img[126*IMGWIDTH+60] == 128){
        printk("Task consumer obstacle detected \n");
    }
    else{
        /* check if image and vertical image are the same*/
        for(int i = 0; i < IMGWIDTH; i++){
            for(int j = 0; j < IMGWIDTH; j++){
                if(img[i*IMGWIDTH+j] != vertical_guide_image_data[i][j]){
                    printk("Error\n");
                    break;
                }
            }
        }

    }

    /* unget image from CAB*/
    unget((void*)img, image_cab);

    k_msleep(1000);

        
  }
}




