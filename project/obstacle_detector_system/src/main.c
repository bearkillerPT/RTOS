// This code was based on the examples folder available on the elearning site, which was based on the nordic documentation examples.
// base documentation: https://developer.nordicsemi.com/nRF_Connect_SDK/doc/latest/zephyr/reference/kernel/index.html

#include <zephyr.h>
#include <device.h>
// #include <drivers/gpio.h>
#include <drivers/uart.h>
#include <sys/printk.h>
#include <sys/__assert.h>
#include <string.h>
#include <timing/timing.h>
#include <stdlib.h>
#include <stdio.h>
#include <stdint.h>
#include <math.h>
#include "cab.h"


// Image constants
#define IMGWIDTH 128             /* Square image. Side size, in pixels*/
#define BACKGROUND_COLOR 0x00    /* Color of the background */
#define GUIDELINE_COLOR 0xFF     /* Guideline color */
#define OBSTACLE_COLOR 0x80      /* Obstacle color */
#define GN_ROW 0                 /* Row to look for the guiode line - close */
#define GF_ROW (IMGWIDTH - 1)    /* Row to look for the guiode line - far */
#define NOB_ROW (IMGWIDTH / 2)   /* Row to look for near obstacles */
#define NOB_COL (IMGWIDTH / 4)   /* Col to look for near obstacles */
#define NOB_WIDTH (IMGWIDTH / 2) /* WIDTH of the sensor area */


uint8_t vertical_guide_image_data[IMGWIDTH][IMGWIDTH] =
    {
        {0, 0, 0, 0, 0, 0, 0, 0, 0, 0, 0, 0, 0,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 0, 0},
        {0, 0, 0, 0, 0, 0, 0, 0, 0, 0, 0, 0, 0,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 0, 0},
        {0, 0, 0, 0, 0, 0, 0, 0, 0, 0, 0, 0, 0,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 0, 0},
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        {0, 0, 0, 0, 0, 0, 0, 0, 0, 0, 0, 0, 0,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 0, 0}};

/* Size of stack area used by each thread (can be thread specific, if necessary)*/
#define STACK_SIZE 1024

#define SAMP_PERIOD_MS 1000

/* Semaphores for task sync */
struct k_sem sem_rcvimg;
struct k_sem sem_rcvimg_nearobs;
struct k_sem sem_rcvimg_orientation;
struct k_sem sem_rcvimg_obscount;
struct k_sem sem_tasks_output;

/* irq keys*/
unsigned int key1;
unsigned int key2;
unsigned int key3;
unsigned int key4;


/* Global vars (shared memory between tasks) */
uint8_t nearobs_output = 0; // Yes(1) or No(0)
char orientation_output [2][10] = {{"000"},{"000.000"}}; // position and angle
uint16_t obscount_output = 0; // obstacle count


/* Thread scheduling priority */
#define thread_receive_image_prio 5 //it may not be the highest... Temos que ver istooooooooooooooooooooooooooooo
#define thread_near_obstacle_prio 4
#define thread_output_prio 3
#define thread_orientation_prio 2
#define thread_obscount_prio 1


/* Create thread stack space */
K_THREAD_STACK_DEFINE(thread_receive_image_stack, STACK_SIZE);
K_THREAD_STACK_DEFINE(thread_near_obstacle_stack, STACK_SIZE);
K_THREAD_STACK_DEFINE(thread_orientation_stack, STACK_SIZE);
K_THREAD_STACK_DEFINE(thread_output_stack, STACK_SIZE);
K_THREAD_STACK_DEFINE(thread_obscount_stack, STACK_SIZE);

/* Create variables for thread data */
struct k_thread thread_receive_image_data;
struct k_thread thread_near_obstacle_data;
struct k_thread thread_orientation_data;
struct k_thread thread_output_data;
struct k_thread thread_obscount_data;


/* Create task IDs */
k_tid_t thread_receive_image_tid;
k_tid_t thread_near_obstacle_tid;
k_tid_t thread_orientation_tid;
k_tid_t thread_output_tid;
k_tid_t thread_obscount_tid;

/* Cab */
cab* image_cab;

uint8_t** castImage(uint8_t* img);

// //UART 
#define FATAL_ERR -1 /* Fatal error return code, app terminates */

#define UART_NODE DT_NODELABEL(uart0)    /* UART Node label, see dts */

#define RXBUF_SIZE IMGWIDTH*IMGWIDTH                   /* RX buffer size */
#define RX_TIMEOUT 1000                  /* Inactivity period after the instant when last char was received that triggers an rx event (in us) */

/* Struct for UART configuration (if using default values is not needed) */
const struct uart_config uart_cfg = {
		.baudrate = 115200,
		.parity = UART_CFG_PARITY_NONE,
		.stop_bits = UART_CFG_STOP_BITS_1,
		.data_bits = UART_CFG_DATA_BITS_8,
		.flow_ctrl = UART_CFG_FLOW_CTRL_NONE
};

/* UAR related variables */
const struct device *uart_dev;          /* Pointer to device struct */ 
static uint8_t rx_buf[RXBUF_SIZE];      /* RX buffer, to store received data */
static uint8_t rx_chars[RXBUF_SIZE];    /* chars actually received  */
// volatile int uart_rxbuf_nchar=0;        /* Number of chars currnetly on the rx buffer */

/* UART callback function prototype */
static void uart_cb(const struct device *dev, struct uart_event *evt, void *user_data);

/* Thread code prototypes */
void thread_near_obstacle_code(void *argA, void *argB, void *argC);
void thread_receive_image_code(void *argA, void *argB, void *argC);
void thread_orientation_code(void *argA, void *argB, void *argC);
void thread_output_code(void *argA, void *argB, void *argC);
void thread_obscount_code(void *argA, void *argB, void *argC);

/* Main function */
void main(void)
{
    //UART
    int err;
    /* Bind to UART */
    uart_dev= device_get_binding(DT_LABEL(UART_NODE));
    if (uart_dev == NULL) {
        printk("device_get_binding() error for device %s!\n\r", DT_LABEL(UART_NODE));
        return;
    }
    else {
        printk("UART binding successful\n\r");
    }

    /* Configure UART */
    err = uart_configure(uart_dev, &uart_cfg);
    if (err == -ENOSYS) { /* If invalid configuration */
        printk("uart_configure() error. Invalid configuration\n\r");
        return; 
    }

    /* Enable data reception */
    err =  uart_rx_enable(uart_dev ,rx_buf,sizeof(rx_buf),RX_TIMEOUT);
    if (err) {
        printk("uart_rx_enable() error. Error code:%d\n\r",err);
        return;
    }

    /* Register callback */
    err = uart_callback_set(uart_dev, uart_cb, NULL);
    if (err) {
        printk("uart_callback_set() error. Error code:%d\n\r",err);
        return;
    }

    /* Initialize cab */
    
    uint8_t **img1 = (uint8_t **)malloc(IMGWIDTH * sizeof(uint8_t *));
    for (uint8_t j = 0; j < IMGWIDTH; j++)
        img1[j] = (uint8_t *)malloc(IMGWIDTH * sizeof(uint8_t));

    for (size_t i = 0; i < IMGWIDTH; i++)
        for (size_t j = 0; j < IMGWIDTH; j++)
            img1[i][j] = vertical_guide_image_data[i][j];


    printk("open cab");
    image_cab = open_cab("image cab", 5, IMGWIDTH*IMGWIDTH, (void*)img1);

    k_sem_init(&sem_rcvimg_nearobs, 0, 1);
    k_sem_init(&sem_rcvimg_orientation, 0, 1);
    k_sem_init(&sem_tasks_output, 0, 1);
    k_sem_init(&sem_rcvimg_obscount, 0, 1);
    k_sem_init(&sem_rcvimg, 0, 1);
    
    
    
    
    /* Create tasks */
    thread_near_obstacle_tid = k_thread_create(&thread_near_obstacle_data, thread_near_obstacle_stack,
                                               K_THREAD_STACK_SIZEOF(thread_near_obstacle_stack), thread_near_obstacle_code,
                                               NULL, NULL, NULL, thread_near_obstacle_prio, 0, K_NO_WAIT);
    thread_receive_image_tid = k_thread_create(&thread_receive_image_data, thread_receive_image_stack,
                                               K_THREAD_STACK_SIZEOF(thread_receive_image_stack), thread_receive_image_code,
                                               NULL, NULL, NULL, thread_receive_image_prio, 0, K_NO_WAIT);
    thread_orientation_tid = k_thread_create(&thread_orientation_data, thread_orientation_stack,
                                               K_THREAD_STACK_SIZEOF(thread_orientation_stack), thread_orientation_code,
                                               NULL, NULL, NULL, thread_orientation_prio, 0, K_NO_WAIT);
    thread_output_tid = k_thread_create(&thread_output_data, thread_output_stack,
                                               K_THREAD_STACK_SIZEOF(thread_output_stack), thread_output_code,
                                               NULL, NULL, NULL, thread_output_prio, 0, K_NO_WAIT);
    thread_obscount_tid = k_thread_create(&thread_obscount_data, thread_obscount_stack,
                                               K_THREAD_STACK_SIZEOF(thread_obscount_stack), thread_obscount_code,
                                               NULL, NULL, NULL, thread_obscount_prio, 0, K_NO_WAIT);
                                            

    return;
}

/* Thread code implementations */

void thread_receive_image_code(void *argA, void *argB, void *argC)
{
    int64_t release_time=0, fin_time=0, t_prev = 0, t_min = SAMP_PERIOD_MS, t_max = SAMP_PERIOD_MS;

    printk("Thread receive_image init\n");

    /* Compute next release instant */
    release_time = k_uptime_get() + SAMP_PERIOD_MS;

    /* Thread loop */
    while (1)
    {
        k_sem_take(&sem_rcvimg, K_FOREVER);
        key4 = irq_lock();
        printk("$Receive image -> %lld\n", (long long) k_uptime_get());

        /* Code for receiving image */
        
        uint8_t * img = (uint8_t*)reserve(image_cab);

        for(int i = 0; i < RXBUF_SIZE; i++){
            img[i] = (uint8_t)rx_chars[i];
        }
        
        put_mes((void*)img, image_cab);
        k_sem_give(&sem_rcvimg_nearobs);
        k_sem_give(&sem_rcvimg_orientation);
        k_sem_give(&sem_rcvimg_obscount);
 
        irq_unlock(key4);
        /*--------------------------*/
        

        /* Wait for next release instant */
        fin_time = k_uptime_get();
        
        if (fin_time - t_prev < t_min)
            t_min = fin_time - t_prev;
        else if (fin_time - t_prev > t_max)
            t_max = fin_time - t_prev;
            
        t_prev = fin_time;

        // printk("Task %s arrived at %lld inter-arrival time (us): min: %lld / max: %lld \n\r", "rcv img", (long long)k_uptime_get(), t_min, t_max);
        
    }
}

void thread_near_obstacle_code(void *argA, void *argB, void *argC)
{
    int64_t release_time = 0, fin_time = 0, t_prev = 0, t_min = SAMP_PERIOD_MS, t_max = SAMP_PERIOD_MS;

    printk("Thread near_obstacle init\n");

    /* Compute next release instant */
    release_time = k_uptime_get() + SAMP_PERIOD_MS;

    /* Thread loop */
    while (1)
    {
        /* Do the workload */
        k_sem_take(&sem_rcvimg_nearobs, K_FOREVER);

        key1=irq_lock();

        // printk("Detecting nearby obstacles...\n");

        uint8_t* cab_img = (uint8_t*)get_mes(image_cab);
        
        uint8_t ** image = castImage(cab_img);

        unget((void*)cab_img, image_cab);

        int i, j;
        uint8_t res=0;

        for (j = NOB_ROW; j < IMGWIDTH; j++)
        {
            int inObs = 0;
            for (i = NOB_COL; i < NOB_COL + NOB_WIDTH; i++)
            {
                if (image[j][i] == OBSTACLE_COLOR)
                {
                    inObs++;
                }
                else if (inObs > 1)
                {
                    inObs = 0;
                }
                if (inObs > 1)
                    res=1;
            }
        }

        
        // free image
        for (i = 0; i < IMGWIDTH; i++)
            free(image[i]);
        free(image);


        nearobs_output = res;
        k_sem_give(&sem_tasks_output);
        
        /* Wait for next release instant */
        fin_time = k_uptime_get();
        
        if (fin_time - t_prev < t_min)
            t_min = fin_time - t_prev;
        else if (fin_time - t_prev > t_max)
            t_max = fin_time - t_prev;
            
        t_prev = fin_time;

        irq_unlock(key1);

        printk("$Near obs -> %lld\n", (long long) k_uptime_get());
        
    }
}

void thread_orientation_code(void *argA, void *argB, void *argC)
{
    int64_t release_time = 0, fin_time = 0, t_prev = 0, t_min = SAMP_PERIOD_MS, t_max = SAMP_PERIOD_MS;
    int16_t pos = -1;
    float angle = -1;
    printk("Thread orientation init\n");

    /* Compute next release instant */
    release_time = k_uptime_get() + SAMP_PERIOD_MS;

    /* Thread loop */
    while (1)
    {
        /* Do the workload */
        k_sem_take(&sem_rcvimg_orientation, K_FOREVER);
        key2 = irq_lock();


        uint8_t* cab_img = (uint8_t*)get_mes(image_cab);
        
        uint8_t ** image = castImage(cab_img);
        unget((void*)cab_img, image_cab);

        // printk("Detecting position and guideline angle...\n");
        int i, gf_pos;

        /* Inits */
        pos = -1;
        gf_pos = -1;

        /* Search for guideline pos - Near*/
        for (i = 0; i < IMGWIDTH; i++)
        {
            if (image[GN_ROW][i] == GUIDELINE_COLOR)
            {
                pos = i;
                break;
            }
        }

        // /* Search for guideline pos - Far*/
        for (i = 0; i < IMGWIDTH; i++)
        {
            if (image[GF_ROW][i] == GUIDELINE_COLOR)
            {
                gf_pos = i;
                break;
            }
        }

        if (pos == -1 || gf_pos == -1)
        {
            printk("Failed to find guideline pos=%d, gf_pos=%d", pos, gf_pos);
            // break;
        }

        /* Approach very grossly the angle (NOT a valid solution - just for testing ) */
        if (pos == gf_pos)
        {
            angle = 0;
        }
        else
        {
            int pos_delta = pos - gf_pos;
            if (pos_delta > 0)
                pos_delta++;
            else
                pos_delta--;
            angle = acos(IMGWIDTH / sqrt(pow(IMGWIDTH, 2) + pow(pos_delta, 2)));
            if (pos_delta > 0)
                angle = -angle;
        }

        // write data on shared memory
        itoa(pos, orientation_output[0], 10);
        gcvt (angle, 6, orientation_output[1]);

        //free image
        for (i = 0; i < IMGWIDTH; i++)
        {
            free(image[i]);
        }
        free(image);

        k_sem_give(&sem_tasks_output);

        
        
        /* Wait for next release instant */
        fin_time = k_uptime_get();
        
        if (fin_time - t_prev < t_min)
            t_min = fin_time - t_prev;
        else if (fin_time - t_prev > t_max)
            t_max = fin_time - t_prev;
            
        t_prev = fin_time;

        irq_unlock(key2);

        printk("$orientation -> %lld\n", (long long) k_uptime_get());

        
    }
}

void thread_output_code(void *argA, void *argB, void *argC)
{
    int64_t release_time = 0, fin_time = 0, t_prev = 0, t_min = SAMP_PERIOD_MS, t_max = SAMP_PERIOD_MS;
    printk("Thread output init\n");

    /* Compute next release instant */
    release_time = k_uptime_get() + SAMP_PERIOD_MS;

    /* Thread loop */
    while (1)
    {
        /* Do the workload */
        k_sem_take(&sem_tasks_output, K_FOREVER);
        
        printk("\tCloseby obstacles detected: %s\n\r", nearobs_output==1? "Yes" : "No");
        
        printk("\tRobot position=%s, guideline angle=%s\n\r", orientation_output[0], orientation_output[1]);

        printk("\t%d obstacles detected\n\r", obscount_output);
        
        /* Wait for next release instant */
        fin_time = k_uptime_get();
        
        if (fin_time - t_prev < t_min)
            t_min = fin_time - t_prev;
        else if (fin_time - t_prev > t_max)
            t_max = fin_time - t_prev;
            
        t_prev = fin_time;

        // printk("Task %s arrived at %lld inter-arrival time (us): min: %lld / max: %lld \n\r", "near obstacle", (long long)k_uptime_get(), t_min, t_max);

        
    }
}

void thread_obscount_code(void *argA, void *argB, void *argC)
{
    int64_t release_time = 0, fin_time = 0, t_prev = 0, t_min = SAMP_PERIOD_MS, t_max = SAMP_PERIOD_MS;

    printk("Thread obscount init\n");

    /* Compute next release instant */
    release_time = k_uptime_get() + SAMP_PERIOD_MS;

    /* Thread loop */
    while (1)
    {
        /* Do the workload */
        k_sem_take(&sem_rcvimg_obscount, K_FOREVER);
        key3 = irq_lock();


        uint8_t* cab_img = (uint8_t*)get_mes(image_cab);
        uint8_t ** image = castImage(cab_img);

        unget((void*)cab_img, image_cab);
    
	    // printk("Detecting number of obstacles ...\n");
        int i, j, nobs;

        /* Inits */
        nobs = 0;

        /* Search for obstacles. */
        for (j = 0; j < IMGWIDTH; j++)
        {
            int inObs = 0;
            for (i = 0; i < IMGWIDTH; i++)
            {
                if (image[j][i] == OBSTACLE_COLOR)
                {
                    inObs++;
                }
                else if (inObs > 1)
                {
                    nobs++;
                    inObs = 0;
                }
            }
            if (inObs > 1)
                nobs++;
        }

        obscount_output = nobs;

        //free image
        for (i = 0; i < IMGWIDTH; i++)
        {
            free(image[i]);
        }
        free(image);

        k_sem_give(&sem_tasks_output);
        
        /* Wait for next release instant */
        fin_time = k_uptime_get();
        
        if (fin_time - t_prev < t_min)
            t_min = fin_time - t_prev;
        else if (fin_time - t_prev > t_max)
            t_max = fin_time - t_prev;
            
        t_prev = fin_time;
        
        printk("$obs count -> %lld\n\n", (long long) k_uptime_get());

        // int err =  uart_rx_enable(uart_dev ,rx_buf,sizeof(rx_buf),RX_TIMEOUT);
        //     if (err) {
        //         printk("uart_rx_enable() error. Error code:%d\n\r",err);
        //         exit(FATAL_ERR);                
        //     }
        
    }
}


/* UART callback implementation */
/* Note that callback functions are executed in the scope of interrupt handlers. */
/* They run asynchronously after hardware/software interrupts and have a higher priority than all threads */
/* Should be kept as short and simple as possible. Heavier processing should be deferred to a task with suitable priority*/
static void uart_cb(const struct device *dev, struct uart_event *evt, void *user_data)
{
    int err;

    switch (evt->type) {
	
        case UART_TX_DONE:
		    printk("UART_TX_DONE event \n\r");
            break;

    	case UART_TX_ABORTED:
	    	printk("UART_TX_ABORTED event \n\r");
		    break;
		
	    case UART_RX_RDY:
		    printk("UART_RX_RDY event \n\r");
            /* Just copy data to a buffer. Usually it is preferable to use e.g. a FIFO to communicate with a task that shall process the messages*/
            printk("Received %d bytes. %d\n", evt->data.rx.len, evt->data.rx.offset);
            if(evt->data.rx.offset + evt->data.rx.len > RXBUF_SIZE){
                printk("Error. Received more data than expected for %d x %d \n", IMGWIDTH, IMGWIDTH);
                // uart_rxbuf_nchar = 0;
                break;
            }
            memcpy(&rx_chars[evt->data.rx.offset],&(rx_buf[evt->data.rx.offset]),evt->data.rx.len); 
            // uart_rxbuf_nchar += evt->data.rx.len; 
                
            if(evt->data.rx.offset + evt->data.rx.len == RXBUF_SIZE){
                // uart_rxbuf_nchar = 0;  
                k_sem_give(&sem_rcvimg);
            }
		    break;

	    case UART_RX_BUF_REQUEST:
		    printk("UART_RX_BUF_REQUEST event \n\r");
		    break;

	    case UART_RX_BUF_RELEASED:
		    printk("UART_RX_BUF_RELEASED event \n\r");
		    break;
		
	    case UART_RX_DISABLED: 
            /* When the RX_BUFF becomes full RX is is disabled automaticaly.  */
            /* It must be re-enabled manually for continuous reception */
            printk("UART_RX_DISABLED event \n\r");
		    err =  uart_rx_enable(uart_dev ,rx_buf,sizeof(rx_buf),RX_TIMEOUT);
            if (err) {
                printk("uart_rx_enable() error. Error code:%d\n\r",err);
                exit(FATAL_ERR);                
            }
		    break;

	    case UART_RX_STOPPED:
		    printk("UART_RX_STOPPED event \n\r");
		    break;
		
	    default:
            printk("UART: unknown event \n\r");
		    break;
    }
    
}

uint8_t** castImage(uint8_t* img){
    uint8_t** image = (uint8_t**)malloc(IMGWIDTH * sizeof(uint8_t*));
    for(int i = 0; i < IMGWIDTH; i++){
        image[i] = (uint8_t*)malloc(IMGWIDTH * sizeof(uint8_t));
    } 

    for(int i = 0; i < IMGWIDTH; i++){
        for(int j = 0; j < IMGWIDTH; j++){
            image[i][j] = img[i*IMGWIDTH + j];
        }
    }
    return image;
}


